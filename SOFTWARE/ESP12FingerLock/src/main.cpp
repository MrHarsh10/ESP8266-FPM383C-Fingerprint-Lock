#include <Arduino.h>
#include <stdio.h>
#include <SoftwareSerial.h>
#include <Ticker.h>
#include <servo.h>
#include <string.h>

#define DebugPrint(message) Serial.print(message)
#define DebugPrintln(message) Serial.println(message)
#define DebugPrintBegin(baud_rate) Serial.begin(baud_rate) 
SoftwareSerial Serial2(4,5);
Servo servo;
Ticker ticker1,ticker2;
uint8_t ReceiveBuffer[30]={0};
uint8_t loopTag=0;uint8_t id;uint32_t score=0;
//0xf1,0x1f,0xe2,0x2e,0xb6,0x6b,0xa8,0x8a,
//普通休眠19
 const uint8_t SleepBuffer[]={0xf1,0x1f,0xe2,0x2e,0xb6,0x6b,0xa8,0x8a,0x00,0x08,0x85,0x00,0x00,0x00,0x00,0x02,0x0c,0x00,0xf2};
//深度休眠19
const uint8_t DeepSleep[]={0xf1,0x1f,0xe2,0x2e,0xb6,0x6b,0xa8,0x8a,0x00,0x08,0x85,0x00,0x00,0x00,0x00,0x02,0x0c,0x01,0xf1};
//更新储存特征值20
 const uint8_t PatternUpdata[]={0xf1,0x1f,0xe2,0x2e,0xb6,0x6b,0xa8,0x8a,0x00,0x09,0x84,0x00,0x00,0x00,0x00,0x01,0x16,0x00,0x00,0xe9};
//灯23
const uint8_t BlueLight[]={0xf1,0x1f,0xe2,0x2e,0xb6,0x6b,0xa8,0x8a,0x00,0x0c,0x81,0x00,0x00,0x00,0x00,0x02,0x0f,0x01,0x04,0x64,0x00,0x00,0x86};
const uint8_t GreenLight[]={0xf1,0x1f,0xe2,0x2e,0xb6,0x6b,0xa8,0x8a,0x00,0x0c,0x81,0x00,0x00,0x00,0x00,0x02,0x0f,0x01,0x01,0x64,0x00,0x00,0x89};
const uint8_t RedLight[]={0xf1,0x1f,0xe2,0x2e,0xb6,0x6b,0xa8,0x8a,0x00,0x0c,0x81,0x00,0x00,0x00,0x00,0x02,0x0f,0x01,0x02,0x64,0x00,0x00,0x88};
const uint8_t LingtOff[]={0xf1,0x1f,0xe2,0x2e,0xb6,0x6b,0xa8,0x8a,0x00,0x0c,0x81,0x00,0x00,0x00,0x00,0x02,0x0f,0x00,0x00,0x00,0x00,0x00,0xef};
//同步指纹匹配18
const uint8_t SynFigerMatch[]={0xf1,0x1f,0xe2,0x2e,0xb6,0x6b,0xa8,0x8a,0x00,0x07,0x86,0x00,0x00,0x00,0x00,0x01,0x23,0xdc};
//异步指纹匹配22
uint8_t AsyncFigerMatch[]={0xf1,0x1f,0xe2,0x2e,0xb6,0x6b,0xa8,0x8a,0x00,0x0b,0x82,0x00,0x00,0x00,0x00,0x01,0x18,0x00,0x03,0xff,0xff,0xe6};
void SendData(const uint8_t buffer[],uint32_t len);
void display();
void ReceiveData(uint32_t Timeout);
void Sleep()
{
  SendData(SleepBuffer,19);
  ReceiveData(2000);
  DebugPrintln("Sleep");
}
void LEDControl(const uint8_t buffer[])
{
  SendData(buffer,23);
  ReceiveData(2000);
  DebugPrintln("LED");
}
boolean FingerMatch(uint8_t &ID);
void LoopTagTo2()
{
  loopTag=0x02;
}
IRAM_ATTR void InterruptFun();

void setup() 
{
servo.attach(14); 
servo.write(0);
Serial2.begin(57600); 
DebugPrintBegin(115200);
pinMode(12,INPUT);
Sleep();
delay(100);
attachInterrupt(digitalPinToInterrupt(12),InterruptFun,RISING);
ReceiveData(1000);
}

void loop() { 
  switch (loopTag)
  {

    case 0x01:
    LEDControl(BlueLight);
    loopTag=0x00;
    if(FingerMatch(id))
    {
      LEDControl(GreenLight);
      servo.write(180);
      ticker1.once(3,LoopTagTo2);

    }
    else
    {
      LEDControl(RedLight);
      ticker1.once(1,LoopTagTo2);
    }
   
    break;
    case 0x02:
    LEDControl(LingtOff);
    loopTag=0x00;
    servo.write(0);
    attachInterrupt(digitalPinToInterrupt(12),InterruptFun,RISING);
    Sleep();
    break;
  }
}

void SendData(const uint8_t buffer[],uint32_t len)
{
  Serial2.write(buffer,len);
  Serial2.flush();
}

void ReceiveData(uint32_t Timeout)
{
   uint8_t i = 0;
  while(Serial2.available() == 0 && (--Timeout))
  {
    delay(1);
  }
  while(Serial2.available() > 0)
  {
    delay(2);
    ReceiveBuffer[i++] = Serial2.read();
    if(i >27) break; 
  }

}

 uint8_t get_checksum(uint8_t data[], uint32_t len)
{
  uint32_t i=0;
  int8_t sum =0;
  for(i=0;i<len;i++) sum += data[i];
  return (uint8_t)((~sum)+1);
}



boolean FingerMatch(uint8_t &ID)
{
  SendData(SynFigerMatch,18);
  ReceiveData(2000);
  if(ReceiveBuffer[15]!=0X01&&ReceiveBuffer[16]!=0x23)
  {
  DebugPrintln("MATCH CMD ERRO");
  return false;
  }
  if(ReceiveBuffer[22]==0X01)
  {
    ID=ReceiveBuffer[26];
    DebugPrintln("Match success");
    return true;
  }
  else
  {
    DebugPrintln("Match failed");
    return false;
  } 
}

void InterruptFun()
{
  loopTag=0x01;
  detachInterrupt(digitalPinToInterrupt(12));
}
